## Documentation/devicetree/bindings/display/bridge/cdns,mhdp.yaml
```yaml
%YAML 1.2
---
$id: "http://devicetree.org/schemas/display/bridge/cdns,mhdp.yaml#"
$schema: "http://devicetree.org/meta-schemas/core.yaml#"

title: Cadence MHDP bridge

maintainers:
  - Swapnil Jakhade <sjakhade@cadence.com>
  - Yuti Amonkar <yamonkar@cadence.com>

properties:
  compatible:
    items:
      - const: ti,j721e-mhdp8546
      - const: cdns,mhdp8546

  clocks:
    items:
      descrption:
        DP bridge clock, it's used by the IP to know how to translate a number of
        clock cycles into a time (which is used to comply with DP standard timings
        and delays).

  reg:
    items:
      - description:
          Register block of mhdptx abp registers upto PHY mapped area(AUX_CONFIG_P).
          The AUX and PMA registers are mapped to associated phy driver.
      - description:
          Register block for DSS_EDP0_INTG_CFG_VP registers in case of TI J7 SoCs.

  phys:
    description: see the Documentation/devicetree/bindings/phy/phy-cadence-torrent.yaml

  phy-names:
    const: dpphy

  interrupts:
    maxItems: 1

  power-domains:
    maxItems: 1
    description: phandle to the associated power domain

  ports:
    type: object
    description:
      Ports as described in Documentation/devictree/bindings/graph.txt
    properties:
       port@0:
         description:
           input port representing the DP bridge input

       port@1:
         description:
           output port representing the DP bridge output
    required:
      - port@0
      - port@1

required:
  - compatible
  - clocks
  - reg
  - phys
  - phy-names
  - ports

additionalProperties: false

examples:
  - |
    mhdp: dp-bridge@f0fb000000 {
        compatible = "ti,j721e-mhdp8546", "cdns,mhdp8546";
        reg = <0xf0 0xfb000000 0x0 0x1000000>,
              <0xf0 0xfc000000 0x0 0x2000000>;
        clocks = <&mhdp_clock>;
        phys = <&dp_phy>;
        phy-names = "dpphy";

        ports {
              #address-cells = <1>;
              #size-cells = <0>;

              port@0 {
                     reg = <0>;
                     dp_bridge_input: endpoint {
                                               remote-endpoint = <&xxx_dpi_output>;
                     };
              };

              port@1 {
                     reg = <1>;
                     dp_bridge_output: endpoint {
                                     remote-endpoint = <&xxx_dp_connector_input>;
                     };
              };
      };
    };
...
```

## Documentation/devicetree/bindings/display/ti/ti,am65x-dss.yaml
```yaml
# SPDX-License-Identifier: (GPL-2.0 OR BSD-2-Clause)
# Copyright 2019 Texas Instruments Incorporated
%YAML 1.2
---
$id: "http://devicetree.org/schemas/display/ti/ti,am65x-dss.yaml#"
$schema: "http://devicetree.org/meta-schemas/core.yaml#"

title: Texas Instruments AM65x Display Subsystem

maintainers:
  - Jyri Sarha <jsarha@ti.com>
  - Tomi Valkeinen <tomi.valkeinen@ti.com>

description: |
  The AM65x TI Keystone Display SubSystem with two output ports and
  two video planes. The first video port supports OLDI and the second
  supports DPI format. The fist plane is full video plane with all
  features and the second is a "lite plane" without scaling support.

properties:
  compatible:
    const: ti,am65x-dss

  reg:
    maxItems: 7
    minItems: 7

  reg-names:
    items:
      - const: common
      - const: vidl1
      - const: vid
      - const: ovr1
      - const: ovr2
      - const: vp1
      - const: vp2

  clocks:
    maxItems: 3
    minItems: 3

  clock-names:
    items:
      - const: fck
      - const: vp1
      - const: vp2

  interrupts:
    maxItems: 1

  power-domains:
    maxItems: 1
    description: phandle to the associated power domain

  port@0:
    type: object
    description:
      The DSS OLDI output port node form video port 1

  port@1:
    type: object
    description:
      The DSS DPI output port node from video port 2

  ti,am65x-oldi-io-ctrl:
    maxItems: 1
    description:
      $ref: "/schemas/types.yaml#/definitions/phandle-array"
      phandle to syscon device node mapping OLDI IO_CTRL registers.
      The mapped range should point to OLDI_DAT0_IO_CTRL, map it and
      following OLDI_DAT1_IO_CTRL, OLDI_DAT2_IO_CTRL, OLDI_DAT3_IO_CTRL,
      and OLDI_CLK_IO_CTRL registers. This property is needed for OLDI
      interface to work.

  max-memory-bandwidth:
    $ref: /schemas/types.yaml#/definitions/uint32
    description:
      Input memory (from main memory to dispc) bandwidth limit in
      bytes per second

  "#address-cells":
    const: 1

  "#size-cells":
    const: 0

required:
  - compatible
  - reg
  - reg-names
  - clocks
  - clock-names
  - interrupts
  - "#address-cells"
  - "#size-cells"

additionalProperties: false

examples:
  - |
       dss: dss@04a00000 {
                compatible = "ti,am65x-dss";
                reg =   <0x0 0x04a00000 0x0 0x1000>, /* common */
                        <0x0 0x04a02000 0x0 0x1000>, /* vidl1 */
                        <0x0 0x04a06000 0x0 0x1000>, /* vid */
                        <0x0 0x04a07000 0x0 0x1000>, /* ovr1 */
                        <0x0 0x04a08000 0x0 0x1000>, /* ovr2 */
                        <0x0 0x04a0a000 0x0 0x1000>, /* vp1 */
                        <0x0 0x04a0b000 0x0 0x1000>; /* vp2 */
                reg-names = "common", "vidl1", "vid",
                        "ovr1", "ovr2", "vp1", "vp2";

                ti,am65x-oldi-io-ctrl = <&dss_oldi_io_ctrl>;

                power-domains = <&k3_pds 67 TI_SCI_PD_EXCLUSIVE>;

                clocks =        <&k3_clks 67 1>,
                                <&k3_clks 216 1>,
                                <&k3_clks 67 2>;
                clock-names = "fck", "vp1", "vp2";

                interrupts = <GIC_SPI 166 IRQ_TYPE_EDGE_RISING>;

                status = "disabled";

                port@0 {
                        reg = <0>;

                        oldi_out0: endpoint {
                                remote-endpoint = <&lcd_in0>;
                        };
                };
        };
```

## Documentation/devicetree/bindings/display/ti/ti,j721e-dss.yaml
```yaml
# SPDX-License-Identifier: (GPL-2.0 OR BSD-2-Clause)
# Copyright 2019 Texas Instruments Incorporated
%YAML 1.2
---
$id: "http://devicetree.org/schemas/display/ti/ti,j721e-dss.yaml#"
$schema: "http://devicetree.org/meta-schemas/core.yaml#"

title: Texas Instruments J721E Display Subsystem

maintainers:
  - Jyri Sarha <jsarha@ti.com>
  - Tomi Valkeinen <tomi.valkeinen@ti.com>

description: |
  The J721E TI Keystone Display SubSystem with four output ports and
  four video planes. There is two full video planes and two "lite
  planes" without scaling support. The video ports can be connected to
  the SoC's DPI pins or to integrated display bridges on the SoC.

properties:
  compatible:
    const: ti,j721e-dss

  reg:
    maxItems: 17
    minItems: 17

  reg-names:
    items:
      - const: common_m
      - const: common_s0
      - const: common_s1
      - const: common_s2
      - const: vidl1
      - const: vidl2
      - const: vid1
      - const: vid2
      - const: ovr1
      - const: ovr2
      - const: ovr3
      - const: ovr4
      - const: vp1
      - const: vp2
      - const: vp3
      - const: vp4
      - const: wp

  clocks:
    maxItems: 5
    minItems: 5

  clock-names:
    items:
      - const: fck
      - const: vp1
      - const: vp2
      - const: vp3
      - const: vp4

  interrupts:
    maxItems: 4

  interrupt-names:
    items:
      - const: common_m
      - const: common_s0
      - const: common_s1
      - const: common_s2

  power-domains:
    maxItems: 1
    description: phandle to the associated power domain

  port@0:
    type: object
    description:
      The output port node form video port 1

  port@1:
    type: object
    description:
      The output port node from video port 2

  port@2:
    type: object
    description:
      The output port node from video port 3

  port@3:
    type: object
    description:
      The output port node from video port 4

  max-memory-bandwidth:
    $ref: /schemas/types.yaml#/definitions/uint32
    description:
      Input memory (from main memory to dispc) bandwidth limit in
      bytes per second

  "#address-cells":
    const: 1

  "#size-cells":
    const: 0

required:
  - compatible
  - reg
  - reg-names
  - clocks
  - clock-names
  - interrupts
  - interrupt-names
  - "#address-cells"
  - "#size-cells"

additionalProperties: false

examples:
  - |
        dss: dss@04a00000 {
                compatible = "ti,j721e-dss";
                reg =
                        <0x00 0x04a00000 0x00 0x10000>, /* common_m */
                        <0x00 0x04a10000 0x00 0x10000>, /* common_s0*/
                        <0x00 0x04b00000 0x00 0x10000>, /* common_s1*/
                        <0x00 0x04b10000 0x00 0x10000>, /* common_s2*/

                        <0x00 0x04a20000 0x00 0x10000>, /* vidl1 */
                        <0x00 0x04a30000 0x00 0x10000>, /* vidl2 */
                        <0x00 0x04a50000 0x00 0x10000>, /* vid1 */
                        <0x00 0x04a60000 0x00 0x10000>, /* vid2 */

                        <0x00 0x04a70000 0x00 0x10000>, /* ovr1 */
                        <0x00 0x04a90000 0x00 0x10000>, /* ovr2 */
                        <0x00 0x04ab0000 0x00 0x10000>, /* ovr3 */
                        <0x00 0x04ad0000 0x00 0x10000>, /* ovr4 */

                        <0x00 0x04a80000 0x00 0x10000>, /* vp1 */
                        <0x00 0x04aa0000 0x00 0x10000>, /* vp2 */
                        <0x00 0x04ac0000 0x00 0x10000>, /* vp3 */
                        <0x00 0x04ae0000 0x00 0x10000>, /* vp4 */

                        <0x00 0x04af0000 0x00 0x10000>; /* wb */
              reg-names = "common_m", "common_s0",
                        "common_s1", "common_s2",
                        "vidl1", "vidl2","vid1","vid2",
                        "ovr1", "ovr2", "ovr3", "ovr4",
                        "vp1", "vp2", "vp3", "vp4",
                        "wb";

                clocks =        <&k3_clks 152 0>,
                                <&k3_clks 152 1>,
                                <&k3_clks 152 4>,
                                <&k3_clks 152 9>,
                                <&k3_clks 152 13>;
                clock-names = "fck", "vp1", "vp2", "vp3", "vp4";

                interrupts = <GIC_SPI 602 IRQ_TYPE_LEVEL_HIGH>,
                             <GIC_SPI 603 IRQ_TYPE_LEVEL_HIGH>,
                             <GIC_SPI 604 IRQ_TYPE_LEVEL_HIGH>,
                             <GIC_SPI 605 IRQ_TYPE_LEVEL_HIGH>;
                interrupt-names = "common_m",
                                  "common_s0",
                                  "common_s1",
                                  "common_s2";

                #address-cells = <1>;
                #size-cells = <0>;
                port@0 {
                        reg = <0>;

                        dpi_out_real0: endpoint {
                                remote-endpoint = <&dp_bridge_input>;
                        };
                };
        };
```

## Documentation/devicetree/bindings/dma/dma-domain.yaml
```yaml
# SPDX-License-Identifier: GPL-2.0
%YAML 1.2
---
$id: http://devicetree.org/schemas/dma/dma-domain.yaml#
$schema: http://devicetree.org/meta-schemas/core.yaml#

title: DMA Domain Controller Definition

maintainers:
  - Vinod Koul <vkoul@kernel.org>

allOf:
  - $ref: "dma-controller.yaml#"

description:
  On systems where multiple DMA controllers available, none Slave (for example
  memcpy operation) users can not be described in DT as there is no device
  involved from the DMA controller's point of view, DMA binding is not usable.
  However in these systems still a peripheral might need to be serviced by or
  it is better to serviced by specific DMA controller.
  When a memcpy is used to/from a memory mapped region for example a DMA in the
  same domain can perform better.
  For generic software modules doing mem 2 mem operations it also matter that
  they will get a channel from a controller which is faster in DDR to DDR mode
  rather then from the first controller happen to be loaded.

  This property is inherited, so it may be specified in a device node or in any
  of its parent nodes.

properties:
  $dma-domain-controller:
    $ref: /schemas/types.yaml#definitions/phandle
    description:
      phande to the DMA controller node which should be used for the device or
      domain.

examples:
  - |
    / {
        model = "Texas Instruments K3 AM654 SoC";
        compatible = "ti,am654";
        interrupt-parent = <&gic500>;
        /* For modules without device, DDR to DDR is faster on main UDMAP */
        dma-domain-controller = <&main_udmap>;
        #address-cells = <2>;
        #size-cells = <2>;
        ...
    };

    &cbass_main {
        /* For modules within MAIN domain, use main UDMAP */
        dma-domain-controller = <&main_udmap>;

        cbass_main_navss: interconnect0 {
            ...
            main_udmap: dma-controller@31150000 {
                compatible = "ti,am654-navss-main-udmap";
                ...
            };
        };
    };

    &cbass_mcu {
        /* For modules within MCU domain, use mcu UDMAP */
        dma-domain-controller = <&mcu_udmap>;

        cbass_mcu_navss: interconnect1 {
            ...
            mcu_udmap: dma-controller@285c0000 {
                compatible = "ti,am654-navss-mcu-udmap";
                ...
            };
        };

        fss: fss@47000000 {
            compatible = "simple-bus";
            #address-cells = <2>;
            #size-cells = <2>;
            ranges;

            ospi0: spi@47040000 {
                compatible = "ti,am654-ospi", "cdns,qspi-nor";
                ...
                /* memcpy channel will be request from mcu_udmap */
            };
        };
    };
...
```
