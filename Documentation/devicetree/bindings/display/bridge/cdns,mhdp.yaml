## Documentation/devicetree/bindings/phy/phy-cadence-torrent.txt
```
Cadence Torrent PHY
-----------------------

Required properties:
- compatible:	cdns,torrent-phy-t0
- clocks:	Must contain an entry in clock-names.
		See ../clocks/clock-bindings.txt for details.
- clock-names:	Must be "phy_clk"
- resets:	Must contain an entry for each in reset-names.
		See ../reset/reset.txt for details.
- reset-names:	Must include "torrent_reset" and "torrent_apb".
		"torrent_reset" must control the reset line to the PHY.
		"torrent_apb" must control the reset line to the APB PHY
		interface.
		interface ("torrent_apb" is optional).
- reg:		register range for the PHY.
- #address-cells: Must be 2
- #size-cells:	Must be 2

Sub-nodes:
  Each group of PHY lanes with a single master lane should be represented as
  a sub-node. Note that the actual configuration of each lane is determined by
  hardware strapping, and must match the configuration specified here.

Sub-node required properties:
- #phy-cells:	Generic PHY binding; must be 0.
- cdns,mlane:	The master lane number.  This is the lowest numbered lane
		in the lane group.
- resets:	Must contain one entry which controls the reset line for the
		master lane of the sub-node.
		See ../reset/reset.txt for details.
- cdns,num-lanes:	Number of lanes in this group.  From 1 to 4.  The
			group is made up of consecutive lanes.
- cdns,phy-type:	Can be PHY_TYPE_PCIE or PHY_TYPE_USB3 or PHY_TYPE_DP, depending on
			configuration of lanes.

For PHY_TYPE_DP max-bit-rate property is required: 
- cdns,max-bit-rate: The maximum bit rate


Example:
	pcie_phy4: pcie-phy@fd240000 {
		compatible = "cdns,torrent-phy-t0";
		reg = <0x0 0xfd240000 0x0 0x40000>,
		      <0x00 0xfd242000 0x0 0x10>;
		resets = <&phyrst 0>, <&phyrst 1>;
		reset-names = "torrent_reset", "torrent_apb";
		clocks = <&phyclock>;
		clock-names = "phy_clk";
		#address-cells = <1>;
		#size-cells = <0>;
		usb_phy0: usb-phy {
				cdns,mlane = <0>;
				resets = <&phyrst 2>;
				cdns,num-lanes = <2>;
				#phy-cells = <0>;
				cdns,phy-type = <PHY_TYPE_USB3>;
		};
		dp_phy0: dp-phy {
				cdns,mlane = <0>;
				resets = <&phyrst 4>;
				cdns,num-lanes = <1>;
				cdns,max-bit-rate = <5400>;
				#phy-cells = <0>;
				cdns,phy-type = <PHY_TYPE_DP>;
		};
	}
	
```

## Documentation/devicetree/bindings/phy/phy-cadence-torrent.yaml
```yaml
%YAML 1.2
---
$id: "http://devicetree.org/schemas/phy/phy-cadence-torrent.yaml#"
$schema: "http://devicetree.org/meta-schemas/core.yaml#"

title: Cadence Torrent SD0801 PHY binding for DisplayPort

description:
  This binding describes the Cadence SD0801 PHY (also known as Torrent PHY)
  hardware included with the Cadence MHDP DisplayPort controller.

maintainers:
  - Swapnil Jakhade <sjakhade@cadence.com>
  - Yuti Amonkar <yamonkar@cadence.com>

properties:
  compatible:
    enum:
      - cdns,torrent-phy
      - ti,j721e-serdes-10g

  '#address-cells':
    const: 1

  '#size-cells':
    const: 0

  clocks:
    maxItems: 1
    description:
      PHY reference clock. Must contain an entry in clock-names.

  clock-names:
    const: refclk

  reg:
    minItems: 1
    maxItems: 2
    items:
      - description: Offset of the Torrent PHY configuration registers.
      - description: Offset of the DPTX PHY configuration registers.

  reg-names:
    minItems: 1
    maxItems: 2
    items:
      - const: torrent_phy
      - const: dptx_phy

  resets:
    description:
      Must contain an entry for each in reset-names.
      See Documentation/devicetree/bindings/reset/reset.txt

  reset-names:
    description:
      Must be "torrent_reset". It controls the reset to the
      torrent PHY.

patternProperties:
  '^torrent-phy@[0-7]+$':
    type: object
    description:
      Each group of PHY lanes with a single master lane should be represented as a sub-node.
    properties:
      reg:
        description:
          The master lane number. This is the lowest numbered lane in the lane group.

      resets:
        description:
          Contains list of resets to get all the link lanes out of reset.

      "#phy-cells":
        description:
          Generic PHY binding.
        const: 0

      cdns,phy-type:
        description:
          Should be PHY_TYPE_DP.
        $ref: /schemas/types.yaml#/definitions/uint32

      cdns,num-lanes:
        description:
          Number of DisplayPort lanes.
        allOf:
          - $ref: /schemas/types.yaml#/definitions/uint32
          - enum: [1, 2, 4]

      cdns,max-bit-rate:
        description:
          Maximum DisplayPort link bit rate to use, in Mbps
        allOf:
          - $ref: /schemas/types.yaml#/definitions/uint32
          - enum: [2160, 2430, 2700, 3240, 4320, 5400, 8100]

    required:
      - reg
      - resets
      - "#phy-cells"
      - cdns,phy-type

required:
  - compatible
  - "#address-cells"
  - "#size-cells"
  - clocks
  - clock-names
  - reg
  - reg-names
  - resets
  - reset-names

additionalProperties: false

examples:
  - |
    #include <dt-bindings/phy/phy.h>
    torrent_phy: phy@f0fb500000 {
          compatible = "cdns,torrent-phy";
          reg = <0xf0 0xfb500000 0x0 0x00100000>,
                <0xf0 0xfb030a00 0x0 0x00000040>;
          reg-names = "torrent_phy", "dptx_phy";
          resets = <&phyrst 0>;
          reset-names = "torrent_reset";
          clocks = <&ref_clk>;
          clock-names = "refclk";
          #address-cells = <1>;
          #size-cells = <0>;
          torrent_phy_dp: torrent-phy@0 {
                    reg = <0>;
                    resets = <&phyrst 1>;
                    #phy-cells = <0>;
                    cdns,phy-type = <PHY_TYPE_DP>;
                    cdns,num-lanes = <4>;
                    cdns,max-bit-rate = <8100>;
          };
    };
...
```
